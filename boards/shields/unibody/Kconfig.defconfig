## boards/shields/unibody/Kconfig.defconfig
```kconfig
if SHIELD_UNIBODY

# Name must be less than 16 characters long!
config ZMK_KEYBOARD_NAME
    default "unibody"

endif
```

## boards/shields/unibody/Kconfig.shield
```kconfig
# No whitespace after the comma or in your keyboard name!
config SHIELD_UNIBODY
    def_bool $(shields_list_contains,unibody)
```
